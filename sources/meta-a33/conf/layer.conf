## sources/meta-a33/conf/layer.conf
```bitbake
# We have a conf and classes directory, append to BBPATH
BBPATH .= ":${LAYERDIR}"

# We have a recipes directory, add to BBFILES
BBFILES += "${LAYERDIR}/recipes*/*/*.bb ${LAYERDIR}/recipes*/*/*.bbappend"

BBFILE_COLLECTIONS += "meta-a33"
BBFILE_PATTERN_meta-a33 := "^${LAYERDIR}/"
BBFILE_PRIORITY_meta-a33 = "15"

LAYERSERIES_COMPAT_meta-a33 = "dunfell kirkstone scarthgap"

BB_NUMBER_THREADS ?= "10"
PARALLEL_MAKE ?= "-j 10"

BBFILES_DYNAMIC += " \
	 qt5-layer:${LAYERDIR}/dynamic-layers/qt5-layer/*/*/*.bb \
	 qt5-layer:${LAYERDIR}/dynamic-layers/qt5-layer/*/*/*.bbappend \
"
```

## sources/meta-a33/conf/machine/rock-cm3-l19v2.conf
```bitbake
#@TYPE: Machine
#@NAME: Radxa Rock 3a
#@DESCRIPTION: ROCK3 is a series of Rockchip RK3566/RK3568 based SBC(Single Board Computer) and Compute Module by Radxa.
#https://wiki.radxa.com/Rock3/3a

require conf/machine/include/rk3568.inc

KERNEL_DEVICETREE = "rockchip/rk3566-radxa-cm3-io-l19v2.dtb"
MACHINE_EXTRA_RRECOMMENDS += "kernel-modules"

UBOOT_MACHINE = "radxa-cm3-io-rk3566_defconfig"
```

## sources/meta-a33/conf/machine/soquartz-64.conf
```bitbake
require conf/machine/include/rk3568.inc

KERNEL_DEVICETREE = "rockchip/rk3566-soquartz-model-a.dtb"
MACHINE_EXTRA_RRECOMMENDS += "kernel-modules"

UBOOT_MACHINE = "soquartz-model-a-rk3566_defconfig"
```
